## main/Kconfig.projbuild
```kconfig
menu "Smart Cooking App"

    config SMART_COOKING_MQTT_BROKER_URI
        string "MQTT Broker URI"
        default "mqtt://192.168.1.100:1883"
        help
            URI of the MQTT broker, e.g. mqtt://192.168.1.100:1883

    config SMART_COOKING_STABILITY_TEST
        bool "Enable stability test diagnostics"
        default n
        help
            When enabled, tasks log stack high-watermark every 30 seconds,
            and control_task also logs heap statistics. Intended for
            stability testing only — do not enable in production builds.

    config SMART_COOKING_CLI
        bool "Enable UART CLI for manual command injection"
        default n
        help
            When enabled, a lightweight CLI task reads single-character
            commands from UART0 (the serial monitor port) and injects them
            into the control command queue. Intended for M3 hardware testing
            before MQTT commands are available. Do not enable in production.

    config SMART_COOKING_FAULT_INJECT
        bool "Enable fault injection overrides for testing"
        default n
        help
            Lowers Profile 0 safety_cutoff to 30 °C and reduces
            HEAT_RISE_MS to 15 s so FAULT_OVERTEMP and
            FAULT_HEATER_FAIL can be tested without real heating hardware.
            Must never be enabled in production builds.

endmenu
```

## sdkconfig.defaults
```kconfig
CONFIG_IDF_TARGET="esp32"
CONFIG_ESPTOOLPY_FLASHSIZE_4MB=y
CONFIG_ESPTOOLPY_FLASHSIZE="4MB"
CONFIG_PARTITION_TABLE_CUSTOM=y
CONFIG_PARTITION_TABLE_CUSTOM_FILENAME="partitions.csv"

# Compiler: optimize for size in all builds
CONFIG_COMPILER_OPTIMIZATION_SIZE=y

# Bluetooth Classic + Bluedroid + Blufi (M4-T1 — FR-07)
CONFIG_BT_ENABLED=y
CONFIG_BT_BLUEDROID_ENABLED=y
CONFIG_BT_BLE_ENABLED=y
CONFIG_BT_BLE_BLUFI_ENABLE=y
CONFIG_BT_BLE_42_FEATURES_SUPPORTED=y

# TLS: Mozilla CA bundle for OTA HTTPS certificate verification (FR-10, NFR-05)
CONFIG_MBEDTLS_CERTIFICATE_BUNDLE=y
CONFIG_MBEDTLS_CERTIFICATE_BUNDLE_DEFAULT_FULL=y

# TLS: enable ECDHE cipher suites required by modern servers (ngrok, Let's Encrypt)
CONFIG_MBEDTLS_KEY_EXCHANGE_ECDHE_RSA=y
CONFIG_MBEDTLS_KEY_EXCHANGE_ECDHE_ECDSA=y

# OTA: enable rollback support — new firmware must call mark_valid or bootloader reverts (NFR-05)
CONFIG_BOOTLOADER_APP_ROLLBACK_ENABLE=y
```

## sdkconfig.defaults.release
```kconfig
# Release overrides — applied on top of sdkconfig.defaults for production builds.
# Usage: idf.py -DSDKCONFIG_DEFAULTS="sdkconfig.defaults;sdkconfig.defaults.release" build

# Logging: WARN in production — captures errors and anomalies, not routine telemetry
CONFIG_LOG_DEFAULT_LEVEL_INFO=n
CONFIG_LOG_DEFAULT_LEVEL_WARN=y
CONFIG_LOG_DEFAULT_LEVEL=2

# Compiler: strip assert() calls in release — no panics on internal invariants in field
CONFIG_COMPILER_OPTIMIZATION_ASSERTION_LEVEL=0

# Stability test: guarantee the stress-test loop is never compiled into a release build
CONFIG_SMART_COOKING_STABILITY_TEST=n

# Stability test: ensure the stress-test loop is always disabled in release builds
CONFIG_SMART_COOKING_STABILITY_TEST=n
```
